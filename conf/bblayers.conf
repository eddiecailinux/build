## conf/bblayers.conf
```bitbake
# POKY_BBLAYERS_CONF_VERSION is increased each time build/conf/bblayers.conf
# changes incompatibly
POKY_BBLAYERS_CONF_VERSION = "2"

BBPATH = "${TOPDIR}"
BBFILES ?= ""
BSPDIR := "${@os.path.abspath(os.path.dirname(d.getVar('FILE', True)) + '/../..')}"
BBLAYERS ?= " \
  ${BSPDIR}/src/poky/meta \
  ${BSPDIR}/src/poky/meta-poky \
  ${BSPDIR}/src/poky/meta-yocto-bsp \
  ${BSPDIR}/src/meta-rockchip \
  "
```
